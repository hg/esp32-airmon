## firmware/main/Kconfig.projbuild
```kconfig
menu "airmon configuration"

config DEV_NAME
	string "Unique device name"
	default "esp"

config TEMPERATURE_PERIOD_SECONDS
	int "Temperature measurement period, seconds"
	range 1 3600
	default 15

config MEASUREMENT_QUEUE_SIZE
	int "Measurement queue size"
	range 1 10000
	default 500
	help
		How many temperature & particulate measurements to keep in queue

config WIFI_SSID
	string "WiFi SSID"
	default "myssid"
	help
		SSID (network name) to connect to

config WIFI_PASSWORD
	string "WiFi Password"
	default "mypassword"
	help
		WiFi password (WPA or WPA2) to use

config MQTT_BROKER_URI
	string "URI of MQTT broker"
	default "mqtts://mqtt.eclipse.org:1833"
	help
		URI of MQTT broker to send measurement data to

config MQTT_PSK
	string "Pre-shared key of MQTT broker"
	default "hex-string-without-psk-hint"

endmenu
```

## firmware/sdkconfig.defaults
```kconfig
CONFIG_LOG_DEFAULT_LEVEL=4
CONFIG_ESP32_PHY_CALIBRATION_AND_DATA_STORAGE=n
CONFIG_ESP32_WIFI_NVS_ENABLED=n
CONFIG_ESP_TLS_PSK_VERIFICATION=y
CONFIG_MQTT_TRANSPORT_WEBSOCKET=n
CONFIG_MQTT_TRANSPORT_WEBSOCKET_SECURE=n
```

## main/Kconfig.projbuild
```kconfig
menu "airmon configuration"

config TEMPERATURE_PERIOD_SECONDS
	int "Temperature measurement period, seconds"
	range 1 3600
	default 15

config PARTICULATE_PERIOD_SECONDS
	int "Particulate measurement period, seconds"
	range 1 86400
	default 900

config MEASUREMENT_QUEUE_SIZE
	int "Measurement queue size"
	range 1 10000
	default 500
	help
		How many temperature & particulate measurements to keep in queue

config WIFI_SSID
	string "WiFi SSID"
	default "myssid"
	help
		SSID (network name) to connect to

config WIFI_PASSWORD
	string "WiFi Password"
	default "mypassword"
	help
		WiFi password (WPA or WPA2) to use

config MQTT_BROKER_URI
	string "URI of MQTT broker"
	default "mqtts://mqtt.eclipse.org"
	help
		URI of MQTT broker to send measurement data to

config MQTT_HINT
	string "MQTT hint"
	default "airmon"

config MQTT_PSK
	string "MQTT pre-shared key in HEX"
	default "deadbeef"
	help
		Pre-shared key for TLS auth as a hex string
endmenu
```

## sdkconfig.defaults
```kconfig
CONFIG_LOG_DEFAULT_LEVEL=4
CONFIG_ESP32_PHY_CALIBRATION_AND_DATA_STORAGE=n
CONFIG_ESP32_WIFI_NVS_ENABLED=n
```
